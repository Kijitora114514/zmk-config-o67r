## Kconfig
```kconfig
config O67R_DISPLAY_BRIGHTNESS
    int "O67R display brightness percentage"
    default 100
    range 0 100
    depends on ZMK_DISPLAY_STATUS_SCREEN_CUSTOM
    help
      Set the display backlight brightness from 0 (off) to 100 (maximum).
```

## boards/shields/o67r/Kconfig.defconfig
```kconfig
if SHIELD_O67R_DONGLE || SHIELD_O67R_USB_DONGLE || SHIELD_O67R_LEFT_CENTRAL

config ZMK_KEYBOARD_NAME
    default "o67r"

config ZMK_SPLIT_ROLE_CENTRAL
    default y

endif # SHIELD_O67R_DONGLE

if SHIELD_O67R_DONGLE || SHIELD_O67R_USB_DONGLE || SHIELD_O67R_PROSPECTOR || SHIELD_O67R_LEFT_CENTRAL || SHIELD_O67R_LEFT || SHIELD_O67R_RIGHT

config ZMK_SPLIT
    default y

endif # SHIELD_O67R_DONGLE || SHIELD_O67R_USB_DONGLE || SHIELD_O67R_PROSPECTOR || SHIELD_O67R_LEFT_CENTRAL || SHIELD_O67R_LEFT || SHIELD_O67R_RIGHT
```

## boards/shields/o67r/Kconfig.shield
```kconfig
config SHIELD_O67R_DONGLE
    def_bool $(shields_list_contains,o67r_dongle)

config SHIELD_O67R_USB_DONGLE
    def_bool $(shields_list_contains,o67r_usb_dongle)

config SHIELD_O67R_PROSPECTOR
    def_bool $(shields_list_contains,o67r_prospector)

config SHIELD_O67R_LEFT_CENTRAL
    def_bool $(shields_list_contains,o67r_left_central)

config SHIELD_O67R_LEFT
    def_bool $(shields_list_contains,o67r_left)

config SHIELD_O67R_RIGHT
    def_bool $(shields_list_contains,o67r_right)
```

## config/west.yml
```yaml
manifest:
  remotes:
    - name: zmkfirmware
      url-base: https://github.com/zmkfirmware
    # Additional modules containing boards/shields/custom code can be listed here as well
    # See https://docs.zephyrproject.org/3.2.0/develop/west/manifest.html#projects
    - name: rschenk
      url-base: https://github.com/rschenk
    - name: carrefinho
      url-base: https://github.com/carrefinho
    - name: amrithvenkat
      url-base: https://github.com/amrithvenkat
    - name: halfdane
      url-base: https://github.com/halfdane
    - name: kot149
      url-base: https://github.com/kot149

  projects:
    - name: zmk
      remote: zmkfirmware
#      revision: v0.3
      revision: main # 4.x
      import: app/west.yml

    # Raytac MDBT50Q
    - name: zmk-component-raytac-dongle
      remote: rschenk
#      revision: v0.3
      revision: v0.4 # 4.x

    # GC9A01A
    - name: gc9a01a_zephyr_driver
      remote: amrithvenkat
      revision: main

    - name: zmk-input-processors
      remote: halfdane
      revision: main
      path: modules/zmk-input-processors

    - name: zmk-mouse-gesture
      remote: kot149
      revision: v1
      path: modules/zmk-mouse-gesture

  self:
    path: config
```

## dts/bindings/input/o67r,cst816s.yaml
```yaml
description: CST816S touchscreen used by the O67R custom status screen

compatible: "o67r,cst816s"

include: i2c-device.yaml

properties:
  irq-gpios:
    type: phandle-array
    required: true
    description: Touch interrupt signal.

  rst-gpios:
    type: phandle-array
    required: true
    description: Touch controller reset signal.
```
